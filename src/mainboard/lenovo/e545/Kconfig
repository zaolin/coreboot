## src/mainboard/lenovo/e545/Kconfig
```kconfig
#
# This file is part of the coreboot project.
#
# Copyright (C) 2012 Advanced Micro Devices, Inc.
#
# This program is free software; you can redistribute it and/or modify
# it under the terms of the GNU General Public License as published by
# the Free Software Foundation; version 2 of the License.
#
# This program is distributed in the hope that it will be useful,
# but WITHOUT ANY WARRANTY; without even the implied warranty of
# MERCHANTABILITY or FITNESS FOR A PARTICULAR PURPOSE.  See the
# GNU General Public License for more details.
#
# You should have received a copy of the GNU General Public License
# along with this program; if not, write to the Free Software
# Foundation, Inc., 51 Franklin St, Fifth Floor, Boston, MA 02110-1301 USA
#

if BOARD_LENOVO_E545

config BOARD_SPECIFIC_OPTIONS # dummy
	def_bool y
	select CPU_AMD_AGESA_FAMILY15_TN
	select NORTHBRIDGE_AMD_AGESA_FAMILY15_TN
	select SOUTHBRIDGE_AMD_AGESA_HUDSON
	select EC_LENOVO_PMH7
	select EC_LENOVO_H8
	select HAVE_OPTION_TABLE
	select HAVE_PIRQ_TABLE
	select HAVE_MP_TABLE
	select HAVE_ACPI_RESUME
	select HAVE_SMI_HANDLER
	select HAVE_ACPI_TABLES
	select BOARD_ROMSIZE_KB_4096
	select GFXUMA
	select UDELAY_LAPIC
	select USBDEBUG_IN_ROMSTAGE

config MAINBOARD_DIR
	string
	default lenovo/e545

config MAINBOARD_PART_NUMBER
	string
	default "Lenovo Thinkpad E545"

config HW_MEM_HOLE_SIZEK
	hex
	default 0x400000

config MAX_CPUS
	int
	default 4

config HW_MEM_HOLE_SIZE_AUTO_INC
	bool
	default n

config IRQ_SLOT_COUNT
	int
	default 11

config RAMTOP
	hex
	default 0x1000000

config HEAP_SIZE
	hex
	default 0xc0000

config RAMBASE
	hex
	default 0x200000

config ONBOARD_VGA_IS_PRIMARY
	bool
	default y

config VGA_BIOS_ID
	string
	default "1002:990b"

config HUDSON_LEGACY_FREE
	bool
	default y

endif # BOARD_LENOVO_E545
```

## src/security/Kconfig
```kconfig
config INTEL_PLATFORM_LOCKDOWN
	bool "Intel Platform Lockdown"
	depends on SOUTHBRIDGE_INTEL_COMMON
	default y
	help
	  Can set Intel Protected Regions, BIOS_CNTL and locks
	  platform against unpriviledged flash attemps and restrict SMM access.

source src/security/crypto/Kconfig
source src/security/flash/Kconfig
source src/security/platform/Kconfig
```

## src/security/crypto/Kconfig
```kconfig
##
## This file is part of the coreboot project.
##
## Copyright (C) 2015 Philipp Deppenwiese <philipp@deppenwiese.net>
##
## This program is free software; you can redistribute it and/or modify
## it under the terms of the GNU General Public License as published by
## the Free Software Foundation; version 2 of the License.
##
## This program is distributed in the hope that it will be useful,
## but WITHOUT ANY WARRANTY; without even the implied warranty of
## MERCHANTABILITY or FITNESS FOR A PARTICULAR PURPOSE.  See the
## GNU General Public License for more details.
##
## You should have received a copy of the GNU General Public License
## along with this program; if not, write to the Free Software
## Foundation, Inc., 51 Franklin St, Fifth Floor, Boston, MA 02110-1301 USA
##

comment "Crypto API"

config CRYPTO_API
	bool "Crypto API support"
	default n
	help
	  If unsure, say N.

config ED25519_SHA512
	bool "ED25519-SHA512 support"
	depends on CRYPTO_API
	default y
	help
	  If unsure, say Y.
```

## src/security/flash/Kconfig
```kconfig
##
## This file is part of the coreboot project.
##
## Copyright (C) 2015 Philipp Deppenwiese <philipp@deppenwiese.net>
##
## This program is free software; you can redistribute it and/or modify
## it under the terms of the GNU General Public License as published by
## the Free Software Foundation; version 2 of the License.
##
## This program is distributed in the hope that it will be useful,
## but WITHOUT ANY WARRANTY; without even the implied warranty of
## MERCHANTABILITY or FITNESS FOR A PARTICULAR PURPOSE.  See the
## GNU General Public License for more details.
##
## You should have received a copy of the GNU General Public License
## along with this program; if not, write to the Free Software
## Foundation, Inc., 51 Franklin St, Fifth Floor, Boston, MA 02110-1301 USA
##

comment "Flash Protections"

config ME_LOCK_PR
	bool "Enable Protected Regions"
	depends on INTEL_PLATFORM_LOCKDOWN
	default n
	help
	  Attention coreboot can only be updated via external flasher
	  after enabling this feature !!!

	  If unsure, say N.

config ME_LOCK_CNTL
	bool "Enable BIOS_CNTL"
	depends on INTEL_PLATFORM_LOCKDOWN
	default n
	help
	  Attention coreboot can only be updated via external flasher
	  after enabling this feature !!!

	  If unsure, say N.
```
